## bsp/starfive/jh7110/driver/Kconfig
```kconfig
menu "RISC-V 64 configs"

config RISCV_S_MODE
    bool "RT-Thread run in RISC-V S-Mode(supervisor mode)"
    default y

config RISCV_DEFINE_PLIC_OFFSET
    bool "define hartid to plic num mapping function"
    default y

config BSP_USING_GPIO
    bool "enable gpio int(linux side can not use gpio int"
    default n

choice
    prompt "Choose Board"

    default BSP_USING_VF2

    config BSP_USING_VF2
        bool "visionfive v2 board"

    config BSP_USING_DEVKITS
        bool "devkits board"

endchoice

endmenu
```

## bsp/starfive/libraries/applications/Kconfig
```kconfig
menu "Application Configuration"

config USING_RPMSG_ECHO_TEST
    bool "Enable RPMSG_ECHO_TEST"
    default n

endmenu
```

## bsp/starfive/libraries/component/Kconfig
```kconfig
menu "component Configuration"

config BSP_USING_RPMSG_LITE
    bool "Enable rpmsg lite driver"
    default n

endmenu
```

## bsp/starfive/libraries/driver/Kconfig
```kconfig
menu "General Drivers Configuration"

config BSP_USING_GMAC
    bool "Enable gmac driver"
    default n
    select RT_USING_GMAC
    if BSP_USING_GMAC
    config BSP_USING_GMAC0
        bool "Enable gmac0"
        default n
    config BSP_USING_GMAC1
        bool "Enable gmac1"
        default n
    config GMAC_DEBUG
        bool "enable GMAC debug print"
	default n
    endif

config BSP_USING_CAN
    bool "Enable can driver"
    default n
    select RT_USING_CAN
    select RT_CAN_USING_CANFD
    if BSP_USING_CAN
    config BSP_USING_CAN0
        bool "Enable CAN 0"
        default n
    config BSP_USING_CAN1
        bool "Enable CAN 1"
        default n
    endif

config BSP_USING_PCIE
    bool "Enable pcie driver"
    default n
    if BSP_USING_PCIE
    config BSP_USING_PCIE0
        bool "Enable pcie 0"
        default n
    config BSP_USING_PCIE1
        bool "Enable pcie 1"
        default n
    endif

config BSP_USING_SPI
    bool "Enable spi driver"
    default n
    select RT_USING_SPI

source "../libraries/driver/pcie/Kconfig"

endmenu
```

## bsp/starfive/libraries/driver/can/Kconfig
```kconfig
menu "CAN Drivers Configuration"

config CAST_CAN
    bool "Enable ipms cast can driver"
    default n
    select BSP_USING_CAN

endmenu
```

## bsp/starfive/libraries/driver/gmac/Kconfig
```kconfig
menu "Ethernet Drivers Configuration"

config DWC_GMAC
    bool "Enable DWC gmac driver"
    default n
    select BSP_USING_GMAC

config RTL_PCIE_GMAC
    bool "Enable realtek pcie gmac driver"
    default n
    select BSP_USING_GMAC
    select BSP_USING_PCIE

endmenu
```

## bsp/starfive/libraries/driver/pcie/Kconfig
```kconfig
menu "pcie Drivers Configuration"

config PLDA_PCIE
    bool "Enable plda driver"
    default n
    select BSP_USING_PCIE

endmenu
```
